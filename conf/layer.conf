## conf/layer.conf
```bitbake
# Layer configuration for meta-handheld layer
# Copyright 2011 Intel Corporation

# We have a conf and classes directory, append to BBPATH
BBPATH .= ":${LAYERDIR}"

# We have a recipes directory, add to BBFILES
BBFILES += "${LAYERDIR}/recipes-*/*/*.bb ${LAYERDIR}/recipes-*/*/*.bbappend"

BBFILE_COLLECTIONS += "meta-handheld"
BBFILE_PATTERN_meta-handheld := "^${LAYERDIR}/"

# Define the priority for recipes (.bb files) from this layer,
# choosing carefully how this layer interacts with all of the
# other layers.

BBFILE_PRIORITY_meta-handheld = "7"

LAYERDEPENDS_meta-handheld = "core meta-initramfs openembedded-layer"

LAYERSERIES_COMPAT_meta-handheld = "sumo thud warrior zeus"
```

## conf/machine/akita.conf
```bitbake
#@TYPE: Machine
#@NAME: Sharp Zaurus SL-C1000
#@DESCRIPTION: Machine configuration for the Sharp Zaurus SL-C1000 device

# NAND factory-default
# mtdparts=sharpsl-nand:7168k@0k(smf),59392k@7168k(root),-(home) 

require conf/machine/include/zaurus.inc
require conf/machine/include/tune-xscale.inc

PACKAGE_EXTRA_ARCHS_tune-xscale += "iwmmxt" 
MACHINE_FEATURES += "iwmmxt"

JFFS2_ERASEBLOCK = "0x20000"

# UBI: max akita (128-7 MiB = 968 PEBs)
# 121 x 1024 : 128 = 968 PEBs
MKUBIFS_ARGS = "-m 2048 -e 129024 -c 968 -x zlib"
UBINIZE_ARGS = "-m 2048 -p 131072 -s 512"

MACHINE_GUI_CLASS = "bigscreen"
MACHINE_DISPLAY_WIDTH_PIXELS = "640"
MACHINE_DISPLAY_HEIGHT_PIXELS = "480"
```

## conf/machine/ben-nanonote.conf
```bitbake
#@TYPE: Machine
#@NAME: Ben Nanonote
#@DESCRIPTION: Machine configuration for the Qi-Hardware's Ben Nanonote

require conf/machine/include/tune-mips32.inc

PREFERRED_PROVIDER_virtual/kernel = "linux-qi-ben-nanonote"

# With 2.6.37 there is not yet uImage target (pending patches)
#KERNEL_IMAGETYPE = "uImage"
KERNEL_IMAGETYPE = "vmlinux.bin"

JFFS2_ERASEBLOCK = "0x80000"

#ScreenInfo
MACHINE_GUI_CLASS = "smallscreen"
MACHINE_DISPLAY_WIDTH_PIXELS = "320"
MACHINE_DISPLAY_HEIGHT_PIXELS = "240"

MACHINE_FEATURES_append_ben-nanonote = " qvga"
```

## conf/machine/c7x0.conf
```bitbake
#@TYPE: Machine
#@NAME: Sharp Zaurus SL-C7x0
#@DESCRIPTION: Machine configuration for the Sharp Zaurus SL-C700, Sharp Zaurus SL-C750, Sharp Zaurus SL-C760, Sharp Zaurus SL-C860 devices

# NAND factory-default
# SL-C700 (corgi) mtdparts=sharpsl-nand:7168k@0k(smf),25600k@7168k(root),-(home)
# SL-C750 (Shepherd) mtdparts=sharpsl-nand:7168k@0k(smf),25600k@7168k(root),-(home)
# SL-C760 (Husky) mtdparts=sharpsl-nand:7168k@0k(smf),54272k@7168k(root),-(home)
# SL-C860 (Boxer) mtdparts=sharpsl-nand:7168k@0k(smf),54272k@7168k(root),-(home)

require conf/machine/include/zaurus.inc
require conf/machine/include/tune-xscale.inc

JFFS2_ERASEBLOCK = "0x4000"

# UBI: max c7x0 (128-7 MiB = 7744 PEBs)
# 121 x 1024 : 16 = 7744 PEBs
MKUBIFS_ARGS = "-m 512 -e 15872 -c 7744 -x zlib"
UBINIZE_ARGS = "-m 512 -p 16384 -s 256"

MACHINE_GUI_CLASS = "bigscreen"
MACHINE_DISPLAY_WIDTH_PIXELS = "640"
MACHINE_DISPLAY_HEIGHT_PIXELS = "480"
```

## conf/machine/collie.conf
```bitbake
#@TYPE: Machine
#@NAME: Sharp Zaurus SL-5000, Sharp Zaurus SL-5500
#@DESCRIPTION: Machine configuration for the SA1100 based Sharp Zaurus SL-5000 and SL-5500 devices

require conf/machine/include/zaurus.inc
require conf/machine/include/tune-strongarm1100.inc

JFFS2_ERASEBLOCK = "0x20000"
# For NOR flash we need the cleanmarkers so override the defaults
EXTRA_IMAGECMD_jffs2 = "--pad=14680064 -l -e ${JFFS2_ERASEBLOCK}"
# sumtool does not accept the argument for --pad
JFFS2_SUM_EXTRA_ARGS = "-p -l -e ${JFFS2_ERASEBLOCK}"

# UBI: max collie (14.125 = 113 PEBs)
# 14.125 x 1024 : 128 = 113 PEBs
MKUBIFS_ARGS = "-m 1 -e 130944 -c 113 -x zlib"
UBINIZE_ARGS = "-m 1 -p 131072"

MACHINE_GUI_CLASS = "smallscreen"
MACHINE_DISPLAY_WIDTH_PIXELS = "240"
MACHINE_DISPLAY_HEIGHT_PIXELS = "320"
```

## conf/machine/gcw0.conf
```bitbake
#@TYPE: Machine
#@NAME: GCW Zero
#@DESCRIPTION: Machine configuration for the Game Consoles Worldwide (GCW) Zero

DEFAULTTUNE = "mips32r2el"
require conf/machine/include/tune-mips32r2.inc

# Factory default are RO images: add following line to your target image
# IMAGE_FEATURES += "read-only-rootfs"
IMAGE_FSTYPES ?= "tar.gz squashfs squashfs-xz"

INITRAMFS_FSTYPES = "cpio.gz cpio.xz"

PREFERRED_PROVIDER_virtual/kernel = "linux-gcw0"

# ELF for kexec (kernel to be put in /boot)
KERNEL_IMAGETYPE = "vmlinuz"
# RAW for ubiboot (only for linux-gcw0-kexecboot)
#KERNEL_IMAGETYPE = "vmlinuz.bin"


MACHINE_GUI_CLASS = "smallscreen"
MACHINE_DISPLAY_WIDTH_PIXELS = "320"
MACHINE_DISPLAY_HEIGHT_PIXELS = "240"
MACHINE_FEATURES = "apm alsa usbhost usbgadget wifi screen qvga vfat ext2"

# Install kernel and symlink in /boot
MACHINE_ESSENTIAL_EXTRA_RDEPENDS_append = " kernel-base kernel-image"
MACHINE_EXTRA_RRECOMMENDS = "kernel-modules"

# Install /boot/boot.cfg in target images and formfactor (psplash checks rotatio
MACHINE_ESSENTIAL_EXTRA_RRECOMMENDS_append = " kexecboot-cfg formfactor"

SERIAL_CONSOLE = "57600 ttyS2"

CMDLINE = "console=ttyS2,57600n8 console=tty0 rfkill.default_state=0"

# dmesg 3.12
# Kernel command line: mem=0x0100M mem=0x0100M@0x30000000   fbcon=bind:0 hwvariant=v20_mddr_512mb panic=5 console=ttyS2,57600 console=tty0 boot=/dev/mmcblk0p1 loop0=/boot/rootfs.squashfs root=/dev/loop0 rfkill.default_state=0

# mininit as init
#CMDLINE = "panic=5 console=ttyS2,57600 console=tty0 boot=/dev/mmcblk0p1 loop0=/boot/rootfs.squashfs root=/dev/loop0 rfkill.default_state=0"

#https://github.com/pcercuei/mininit
#This simple program permits to use a romfs/squashfs image as the root filesystem of a linux system.
#You will need to specify three parameters on the kernel command line:
#- 'boot=X' where X is a comma-separated list of the possible locations for the filesystem on which is stored the image;
#- 'loop0=X' where X is the path to the image (e.g. /boot/rootfs.bin);
#- 'root=/dev/loop0' which defines the loopback mount as being the root file system.
```

## conf/machine/h1910.conf
```bitbake
#@TYPE: Machine
#@NAME: HP iPAQ H1910/H1915
#@DESCRIPTION: Machine configuration for the HP iPAQ H1910/H1915

#
# Hardware-based properties
#
require conf/machine/include/tune-xscale.inc

MACHINE_GUI_CLASS = "smallscreen"
MACHINE_DISPLAY_WIDTH_PIXELS = "240"
MACHINE_DISPLAY_HEIGHT_PIXELS = "320"
MACHINE_FEATURES = "touchscreen apm alsa irda usbgadget screen vfat qvga"

#
# Software/packages selection
#
PREFERRED_PROVIDER_virtual/kernel = "linux-handhelds-2.6"

JFFS2_ERASEBLOCK = "0x4000"

#
# Modules autoload and other boot properties
#
SERIAL_CONSOLE = "115200 ttyS0 vt100"
```

## conf/machine/h1940.conf
```bitbake
#@TYPE: Machine
#@NAME: h1940
#@DESCRIPTION: Machine configuration for the HP iPAQ h1930 and h1940

#
# Hardware-based properties
#
# tune for armv4t
require conf/machine/include/tune-arm920t.inc

# Set preferred providers
PREFERRED_PROVIDER_virtual/kernel = "linux-handheld"

KERNEL_IMAGETYPE = "uImage"
UBOOT_LOADADDRESS = "0x30108000"
UBOOT_ENTRYPOINT = "0x30108000"

IMAGE_FSTYPES += "tar.gz jffs2"
JFFS2_ERASEBLOCK = "0x4000"

# Set features for task-base
MACHINE_GUI_CLASS = "smallscreen"
MACHINE_DISPLAY_WIDTH_PIXELS = "240"
MACHINE_DISPLAY_HEIGHT_PIXELS = "320"
MACHINE_FEATURES = "touchscreen apm bluetooth irda usbgadget screen vfat qvga"

# Some extra configuration
SERIAL_CONSOLE = "115200 ttySAC2 vt100"
USE_VT = "0"
```

## conf/machine/h2200.conf
```bitbake
#@TYPE: Machine
#@NAME: HP iPAQ h22xx
#@DESCRIPTION: Machine configuration for the HP iPAQ h22xx

#
# Hardware-based properties
#
#Compile with armv5te optimizations, incompatible with armv4(t) cpus
require conf/machine/include/tune-xscale.inc

#Set some hints for metadata  
MACHINE_FEATURES = "touchscreen apm alsa pcmcia bluetooth irda usbgadget screen vfat qvga"

#
# Software/packages selection
#
PREFERRED_PROVIDER_virtual/kernel = "linux-handhelds-2.6"

MACHINE_ESSENTIAL_EXTRA_RDEPENDS = " kernel h2200-bootloader "
MACHINE_EXTRA_RDEPENDS = " udev-hostap-cs-vcc-workaround "
MACHINE_EXTRA_RRECOMMENDS = "\
    kernel-module-snd-h2200-audio \
    kernel-module-i2c-pxa \
    "

EXTRA_IMAGECMD_jffs2 = "--pad --eraseblock=0x4000"

#
# Modules autoload and other boot properties
#
module_autoload_snd-pcm-oss 	= "snd-pcm-oss"
module_autoload_snd-mixer-oss = "snd-mixer-oss"
module_autoload_snd-h2200-audio = "snd-h2200-audio"
module_autoload_g_ether = "g_ether"

SERIAL_CONSOLE = "115200 ttyS0 vt100"
USE_VT = "0"

require conf/machine/include/LAB-settings.inc
```

## conf/machine/h3600.conf
```bitbake
#@TYPE: Machine
#@NAME: Compaq iPAQ 36xx,Compaq iPAQ 37xx,Compaq iPAQ 38xx
#@DESCRIPTION: Machine configuration for the Compaq iPAQ 36xx, Compaq iPAQ 37xx and Compaq iPAQ 38xx devices

#
# Hardware-based properties
#
require conf/machine/include/tune-strongarm1100.inc

MACHINE_GUI_CLASS = "smallscreen"
MACHINE_DISPLAY_WIDTH_PIXELS = "240"
MACHINE_DISPLAY_HEIGHT_PIXELS = "320"
MACHINE_FEATURES = "touchscreen apm alsa irda usbgadget screen vfat ext2 qvga"

#
# Software/packages selection
#
PREFERRED_PROVIDER_virtual/kernel = "linux-handheld"
KERNEL_IMAGETYPE ?= "zImage"
# Compression level for 32MB RAM
XZ_COMPRESSION_LEVEL = "-2e"

INITRAMFS_FSTYPES ?= "cpio.gz cpio.lzma"

IMAGE_DEVICE_TABLES = ""

IMAGE_FSTYPES += "tar.gz jffs2"
MACHINE_ESSENTIAL_EXTRA_RDEPENDS = "kernel ipaq-boot-params"
MACHINE_EXTRA_RDEPENDS = "mtd-utils mtd-utils-jffs2"

MACHINE_EXTRA_RRECOMMENDS = ""

JFFS2_ERASEBLOCK = "0x40000"
# For NOR flash we need the cleanmarkers so override the defaults
EXTRA_IMAGECMD_jffs2 = "-p -l -e ${JFFS2_ERASEBLOCK}"
EXTRA_IMAGECMD_jffs2_append = " ; echo '${IMAGE_NAME}  ${IMAGE_NAME}.rootfs.jffs2 - root' >> ${IMGDEPLOYDIR}/reflash.ctl"

#
# Modules autoload and other boot properties
#
CMDLINE = "console=ttySA0,115200n8 console=tty1 fbcon=rotate:1"
SERIAL_CONSOLE = "115200 ttySA0"
USE_VT = "0"
```

## conf/machine/h3900.conf
```bitbake
#@TYPE: Machine
#@NAME: HP iPAQ h39xx
#@DESCRIPTION: Machine configuration for the HP iPAQ h39xx

#
# Hardware-based properties
#
require conf/machine/include/tune-xscale.inc

MACHINE_FEATURES = "touchscreen apm alsa irda bluetooth usbgadget screen vfat qvga"

#
# Software/packages selection
#
PREFERRED_PROVIDER_virtual/kernel = "linux-handhelds-2.6"

MACHINE_EXTRA_RDEPENDS = "kernel ipaq-boot-params"

#
# Modules autoload and other boot properties
#
module_autoload_snd-pcm-oss = "snd-pcm-oss"
module_autoload_g_ether = "g_ether"

SERIAL_CONSOLE = "115200 ttyS0 vt100"
USE_VT = "0"

require conf/machine/include/LAB-settings.inc
```

## conf/machine/h5000.conf
```bitbake
#@TYPE: Machine
#@NAME: Compaq iPAQ 51xx, Compaq iPAQ 54xx, Compaq iPAQ 55xx
#@DESCRIPTION: Machine configuration for the Compaq iPAQ 51xx, Compaq iPAQ 54xx, and Compaq iPAQ 55xx devices

#
# Hardware-based properties
#
require conf/machine/include/tune-xscale.inc

ROOT_FLASH_SIZE = "32"
VOLATILE_STORAGE_SIZE = "64"
MACHINE_FEATURES = "touchscreen apm alsa pcmcia bluetooth irda wifi usbgadget usbhost screen vfat qvga"

#
# Software/packages selection
#
PREFERRED_PROVIDER_virtual/kernel = "linux-handhelds-2.6"
EXTRA_IMAGECMD_jffs2 = "-e 0x40000 -p ; echo '${IMAGE_NAME}  ${IMAGE_NAME}.rootfs.jffs2 - root' >> ${DEPLOY_DIR_IMAGE}/reflash.ctl"

# Ship complete set of modules ('kernel-modules') for easier debug purposes 
MACHINE_EXTRA_RDEPENDS = "kernel ipaq-boot-params"
MACHINE_EXTRA_RRECOMMENDS = " kernel-modules \
                              kernel-module-h5400-lcd \
			      kernel-module-h5400-battery \
			      kernel-module-h5400-bt \
			      kernel-module-snd-soc-h5000 \
			      kernel-module-i2c-pxa \
			      at76c503a-modules"

#
# Modules autoload and other boot properties
#
module_autoload_snd-pcm-oss = "snd-pcm-oss"
module_autoload_snd-mixer-oss = "snd-mixer-oss"
module_autoload_snd-soc-h5000 = "snd-soc-h5000"
module_autoload_g_ether = "g_ether"

SERIAL_CONSOLE = "115200 ttyS0 vt100"
USE_VT = "0"
```

## conf/machine/hx4700.conf
```bitbake
#@TYPE: Machine
#@NAME: HP iPAQ hx47xx
#@DESCRIPTION: Machine configuration for the hx4700 iPAQ with a pxa27x CPU

#
# Hardware-based properties
#
require conf/machine/include/tune-xscale.inc

MACHINE_FEATURES += "iwmmxt"
PACKAGE_EXTRA_ARCHS_tune-xscale += "iwmmxt"

MACHINE_GUI_CLASS = "bigscreen"
MACHINE_DISPLAY_WIDTH_PIXELS = "480"
MACHINE_DISPLAY_HEIGHT_PIXELS = "640"
MACHINE_FEATURES = "alsa apm bluetooth irda pcmcia screen touchscreen usbgadget wifi vfat"

#
# Software/packages selection
#
PREFERRED_PROVIDER_virtual/kernel = "linux-handheld"

XSERVER = "xserver-xorg \
           xf86-input-evdev \
           xf86-video-fbdev"

MACHINE_EXTRA_RDEPENDS = "tiinit acx-firmware"
MACHINE_EXTRA_RRECOMMENDS = "\
	kernel-module-i2c-pxa \
	kernel-module-pxa27x-voltage \
	kernel-module-pxa27x-voltage-max158xx \
	kernel-module-acx \
	kernel-module-hx4700-acx \
	kernel-module-hx4700-bt \
	kernel-module-snd-hx4700-audio \
        keymaps"

IMAGE_FSTYPES += "tar.gz jffs2"
JFFS2_ERASEBLOCK = "0x40000"

#write out a reflash.ctl with the appriate entries for the rootfs, the ones for the kernel should already be there
EXTRA_IMAGECMD_jffs2_append = " ; echo '${IMAGE_NAME}  ${IMAGE_NAME}.rootfs.jffs2 - root' >> ${IMGDEPLOYDIR}/reflash.ctl"

#
# Modules autoload and other boot properties
#
module_autoload_evdev = "evdev"
module_autoload_hx4700_power = "hx4700_power"
module_autoload_pcmcia = "pcmcia"
module_autoload_hx4700_pcmcia = "hx4700_pcmcia"
module_autoload_asic3_mmc = "asic3_mmc"
module_autoload_mmc_block = "mmc_block"
module_autoload_hx4700_ts = "hx4700_ts"
module_autoload_hx4700_navpt = "hx4700_navpt"
module_autoload_hx4700_bt = "hx4700_bt"
module_autoload_snd-hx4700_audio = "snd-hx4700_audio"
module_autoload_snd-pcm-oss = "snd-pcm-oss"
module_autoload_snd-mixer-oss = "snd-mixer-oss"
module_autoload_pxa27x_udc = "pxa27x_udc"

#FIXME: this should be controlled by a userspace utility later.
module_autoload_g_ether = "g_ether"

SERIAL_CONSOLE = "115200 ttyS0"
```

## conf/machine/include/motorola-ezx-base.inc
```bitbake
#
# Hardware-based properties
#

require conf/machine/include/tune-xscale.inc

MACHINE_FEATURES = "alsa apm bluetooth keyboard phone screen touchscreen usbgadget usbhost vfat qvga"
MACHINE_FEATURES += " iwmmxt"

PACKAGE_EXTRA_ARCHS_tune-xscale += "iwmmxt"

#cat /proc/mtd
#dev:    size   erasesize  name
#mtd0: 00020000 00008000 "Bootloader"
#mtd1: 000e0000 00020000 "Kernel"
#mtd2: 00580000 00020000 "VFM_Filesystem"
#mtd3: 00020000 00020000 "Logo"

MACHINE_GUI_CLASS = "smallscreen"
MACHINE_DISPLAY_WIDTH_PIXELS = "240"
MACHINE_DISPLAY_HEIGHT_PIXELS = "320"

#
# Software/packages selection
#
PREFERRED_PROVIDER_virtual/kernel ?= "openezx-kernel"

IMAGE_FSTYPES ?= "jffs2"
JFFS2_ERASEBLOCK = "0x20000"
EXTRA_IMAGECMD_jffs2 = "--pad=14680064 --little-endian --eraseblock=${JFFS2_ERASEBLOCK}"

# In order to enable UIBIFS add "uibi and ubifs"
#IMAGE_FSTYPES += "ubi ubifs"

# From dmesg:
# UBI: smallest flash I/O unit:    1
# UBI: logical eraseblock size:    131072 bytes
# from ubiattach stdout:
# UBI device number 0, total 1996 LEBs
MKUBIFS_ARGS = "-m 1 -e 130944 -c 487"

# from dmesg:
# UBI: smallest flash I/O unit:    1
# UBI: physical eraseblock size:   131072 bytes (128 KiB)
# UBI: sub-page size:              512
UBINIZE_ARGS = "-m 1 -p 128KiB "


EXTRA_IMAGEDEPENDS += "moto-boot-usb-native ezx-gen-blob"

IMAGE_INSTALL_append += "\
  kernel-module-ohci-hcd \
  kernel-module-moto-usb-ipc \
  kernel-module-ts27010mux \
"

# Ezxd needs to be started very early so we need the mux devices in static /dev
IMAGE_DEVICE_TABLES = "files/device_table-minimal.txt \
                       files/device_table-ezx.txt"

SERIAL_CONSOLE = "115200 ttyS0"
```
