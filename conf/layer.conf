## conf/machine/include/zaurus.inc
```bitbake
########################
# Zaurus common settings
########################

IMAGE_FSTYPES ?= "tar.gz jffs2 jffs2.sum ubi ubifs"
IMAGE_FSTYPES:collie ?= "tar.gz jffs2 jffs2.sum"
JFFS2_SUM_EXTRA_ARGS = "-p -l -e ${JFFS2_ERASEBLOCK} -n"

INITRAMFS_FSTYPES ?= "cpio.gz cpio.xz"
IMAGE_DEVICE_TABLES = ""

#########
# xserver
#########

# Zaurus gets preferred providers settings
# from distro/include/default-providers.inc
XSERVER = "xserver-xorg xf86-video-fbdev xf86-input-keyboard xf86-input-mouse xf86-input-evdev xinput-calibrator"

########
# kernel
########

PREFERRED_PROVIDER_virtual/kernel = "linux-handheld"

# Default bootloader expects "zImage", use "uImage" for u-boot
# Note: kexecboot can boot both kind of images
KERNEL_IMAGETYPE ?= "zImage"

# sane defaults for devices with only 32Mb RAM (see man xz)
XZ_COMPRESSION_LEVEL = "-2e"

################
# machine tuning
################

ARM_INSTRUCTION_SET = "thumb"
ARM_INSTRUCTION_SET:collie = "arm"

SERIAL_CONSOLE = "115200 ttyS0"
SERIAL_CONSOLE:collie = "115200 ttySA0"

CMDLINE:akita = "console=ttyS0,115200n8 console=tty1 fbcon=rotate:1"
CMDLINE:c7x0 = "console=ttyS0,115200n8 console=tty1"
CMDLINE:collie = "console=ttySA0,115200n8 console=tty1 mem=64M fbcon=rotate:1"
CMDLINE:poodle = "console=ttyS0,115200n8 console=tty1 fbcon=rotate:1"
CMDLINE:spitz = "console=ttyS0,115200n8 console=tty1 fbcon=rotate:1"
CMDLINE:tosa = "console=ttyS0,115200n8 console=tty1"

MACHINE_FEATURES = "apm alsa pcmcia irda usbgadget keyboard touchscreen screen vfat ext2"
MACHINE_FEATURES:append:akita = " usbhost"
MACHINE_FEATURES:append:collie  = " qvga"
MACHINE_FEATURES:append:poodle  = " qvga"
MACHINE_FEATURES:append:spitz = " usbhost"
MACHINE_FEATURES:append:tosa  = " usbhost wifi"

MACHINE_EXTRA_RDEPENDS = "zaurusd mtd-utils mtd-utils-jffs2 mtd-utils-ubifs nandlogical"
MACHINE_EXTRA_RDEPENDS:collie = "zaurusd mtd-utils mtd-utils-jffs2 mtd-utils-ubifs"

BAD_RECOMMENDATIONS += "eudev-hwdb"

##################################
# Zaurus rootfs are booted by
# linux-kexecboot
##################################

# If set here, each image will also build linux-kexecboot and the updater
# EXTRA_IMAGEDEPENDS += "zaurus-installer"

# Install /boot/boot.cfg in target images and formfactor (psplash checks rotation)
MACHINE_ESSENTIAL_EXTRA_RRECOMMENDS:append = " kexecboot-cfg formfactor"

# Install kernel and symlink in /boot
MACHINE_ESSENTIAL_EXTRA_RDEPENDS:append = " kernel-base kernel-image"
```

## conf/machine/jornada56x.conf
```bitbake
#@TYPE: Machine
#@NAME: HP Jornada 56x
#@DESCRIPTION: Machine configuration for the SA1100 based HP Jornada 56x palmtop computer

PREFERRED_PROVIDER_virtual/kernel = "linux-handhelds-2.6"
PREFERRED_PROVIDERS += "virtual/${TARGET_PREFIX}depmod:module-init-tools-cross"
BOOTSTRAP_EXTRA_RDEPENDS = "kernel kernel-modules module-init-tools" 

JFFS2_ERASEBLOCK = "0x40000"
# For NOR flash we need the cleanmarkers so override the defaults
EXTRA_IMAGECMD_jffs2 = "-p -l -e ${JFFS2_ERASEBLOCK}"

SERIAL_CONSOLE = "115200 ttySA0"

MACHINE_FEATURES_append_jornada56x = " qvga"

require conf/machine/include/tune-strongarm1100.inc
```

## conf/machine/jornada6xx.conf
```bitbake
#@TYPE: Machine
#@NAME: HP Jornada 680
#@DESCRIPTION: Machine configuration for the HITACHI SH3 based HP Jornada 6xx palmtop computer

require conf/machine/include/tune-sh3.inc

MACHINE_FEATURES = "alsa pcmcia irda keyboard touchscreen screen vfat"
MACHINE_EXTRA_RRECOMMENDS = " kernel-modules"

PREFERRED_PROVIDER_virtual/kernel = "linux-jlime-jornada6xx"
PREFERRED_VERSION_linux-jlime-jornada6xx = "2.6.17"

SYSVINIT_ENABLED_GETTYS = "1 2"
```

## conf/machine/jornada7xx.conf
```bitbake
#@TYPE: Machine
#@NAME: HP Jornada 7xx 
#@DESCRIPTION: Machine configuration for the SA1110 based HP Jornada 7xx palmtop computer

require conf/machine/include/tune-strongarm1100.inc

PREFERRED_PROVIDER_virtual/kernel = "linux-jlime-jornada7xx"
MACHINE_FEATURES = "apm alsa pcmcia irda keyboard touchscreen screen vfat"
MACHINE_EXTRA_RDEPENDS = "kernel-modules bluez-dtl1-workaround"

JFFS2_ERASEBLOCK = "0x40000"
# For NOR flash we need the cleanmarkers so override the defaults
EXTRA_IMAGECMD_jffs2 = "-p -l -e ${JFFS2_ERASEBLOCK}"

#screeninfo
MACHINE_GUI_CLASS = "smallscreen"
MACHINE_DISPLAY_WIDTH_PIXELS = "640"
MACHINE_DISPLAY_HEIGHT_PIXELS = "240"

SYSVINIT_ENABLED_GETTYS = "1 2 3 4 5 6"
```

## conf/machine/palmtc.conf
```bitbake
#@TYPE: Machine
#@NAME: Palm TC
#@DESCRIPTION: Machine configuration for the Palm Tungsten C

require conf/machine/include/palm.inc

MACHINE_FEATURES += "wifi"

SERIAL_CONSOLE = "115200 ttyS0"
```

## conf/machine/palmtt.conf
```bitbake
#@TYPE: Machine
#@NAME: Palm Tungsten T
#@DESCRIPTION: Machine configuration for Palm Tungsten T/T2

MACHINE_GUI_CLASS = "bigscreen"
MACHINE_DISPLAY_WIDTH_PIXELS = "320"
MACHINE_DISPLAY_HEIGHT_PIXELS = "320"

PREFERRED_PROVIDER_virtual/kernel = "linux-palm-omap1"

SERIAL_CONSOLE ?= "115200 ttyS0"

JFFS2_ERASEBLOCK = "0x40000"

require conf/machine/include/tune-arm926ejs.inc
```

## conf/machine/palmtt3.conf
```bitbake
#@TYPE: Machine
#@NAME: Palm Tungsten|T3
#@DESCRIPTION: Machine configuration for the Palm Tungsten|T3

require conf/machine/include/palm.inc

SERIAL_CONSOLE = "115200 ttyS3"
```

## conf/machine/palmtt5.conf
```bitbake
#@TYPE: Machine
#@NAME: Palm Tungsten T5
#@DESCRIPTION: Machine configuration for the Palm Tungsten T5

require conf/machine/include/palm.inc

SERIAL_CONSOLE = "115200 ttyS0"

MACHINE_EXTRA_RRECOMMENDS += "kernel-module-pxa27x-keyboard \
                           kernel-module-wm97xx-ts \
                           kernel-module-palmt5-battery"
```

## conf/machine/palmz71.conf
```bitbake
#@TYPE: Machine
#@NAME: Palm Zire 71
#@DESCRIPTION: Machine configuration for Palm Zire 71

PREFERRED_PROVIDER_virtual/kernel = "linux-palm-omap1"
PREFERRED_PROVIDERS += "virtual/${TARGET_PREFIX}depmod:module-init-tools-cross"

SERIAL_CONSOLE ?= "115200 ttyS0"

JFFS2_ERASEBLOCK = "0x40000"

require conf/machine/include/tune-arm926ejs.inc
```

## conf/machine/palmz72.conf
```bitbake
#@TYPE: Machine
#@NAME: Palm Zire 72
#@DESCRIPTION: Machine configuration for the Palm Zire 72

require conf/machine/include/palm.inc

SERIAL_CONSOLE = "115200 ttyS0"

MACHINE_EXTRA_RRECOMMENDS += "kernel-module-i2c-pxa \
			     kernel-module-i2c-algo-pxa \
			     kernel-module-i2c-dev \
			     kernel-module-wm97xx-ts \		
			     kernel-module-palmz72-battery"

module_autoload_g_ether = "g_ether"
```

## conf/machine/poodle.conf
```bitbake
#@TYPE: Machine
#@NAME: Sharp Zaurus SL-B500, Sharp Zaurus SL-5600
#@DESCRIPTION: Machine configuration for the PXA250 based Sharp Zaurus SL-B500 and SHarp Zaurus SL-5600 devices

# NAND factory-default
# SL-5600 (poodle) mtdparts=sharpsl-nand:7168k@0k(smf),22528k@7168k(root),-(home)

require conf/machine/include/zaurus.inc
require conf/machine/include/tune-xscale.inc

JFFS2_ERASEBLOCK = "0x4000"

# UBI: max poodle (64-7 MiB = 3648 PEBs)
# 57 x 1024 : 16 = 3648 PEBs
MKUBIFS_ARGS = "-m 512 -e 15872 -c 3648 -x zlib"
UBINIZE_ARGS = "-m 512 -p 16384 -s 256"

MACHINE_GUI_CLASS = "smallscreen"
MACHINE_DISPLAY_WIDTH_PIXELS = "240"
MACHINE_DISPLAY_HEIGHT_PIXELS = "320"
```
